#include "matrixLeds.h"

const uint8_t PROGMEM FONT[]
{
  0,    // 0 - 'Empty Cell'
  5, 124, 218, 242, 218, 124,    // 1 - 'Sad Smiley'
  5, 124, 214, 242, 214, 124,    // 2 - 'Happy Smiley'
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  5, 254, 130, 130, 130, 254,    // 127 - 'Hollow Block'
};

uint8_t TEXT_FRAME[MAX_BUFFER];


unsigned long GetTextFrame(char c[], uint8_t padding)
{
  uint8_t frame_index = 0;
  int string_index = 0;
  uint8_t *font_pt;
  while (c[string_index] != '\n' && c[string_index] != '\0' && frame_index < MAX_BUFFER)
  {
    font_pt = FONT;
    if (c[string_index] > 127)
    {
      string_index++;
      continue;
    }
    
    
    
    for (uint8_t index = 0; index < c[string_index]; index++)
    {
      font_pt += (pgm_read_byte(font_pt) + 1);
    }
    uint8_t char_width = pgm_read_byte(font_pt);
    for (uint8_t index = 0; index < char_width; index++)
    {
      TEXT_FRAME[frame_index] = pgm_read_byte(++font_pt);
      frame_index++;
      delay(1);
    }
    for (uint8_t count = 0; count < padding; count++)
    {
      TEXT_FRAME[frame_index] = 0;
      frame_index++;
    }
    
    string_index++; 

  }

  return frame_index;
}

void AnimateText(char c[], uint8_t padding, unsigned long duration, enum Direction direction = D_LEFT)
{
  unsigned long text_length = GetTextFrame(c, padding);
  SetAnimationbyFrame(1, text_length , TEXT_FRAME , duration, direction);
}
